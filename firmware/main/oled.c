/* SSD1306 / SH1106 over I²C, page addressing, 6 lines of 5x7 text.
 *
 * Hand-written rather than pulling in a graphics library: this screen shows six
 * lines of monospace text and nothing else, and a font plus twelve register
 * writes is smaller than the dependency would be. The app's look is the same
 * decision (§6) — an instrument, not a UI.
 *
 * **1.3" panels on this board are SH1106**, which is a 132-column controller
 * showing columns 2..129, so every page write starts at column 2. On an SSD1306
 * the same offset simply shifts the image 2 px right, which is why the driver
 * does not need to know which one it is talking to.
 */
#include "oled.h"

#include <stdio.h>
#include <string.h>

#include "board_pins.h"
#include "board.h"
#include "driver/i2c_master.h"
#include "esp_log.h"

static const char *TAG = "oled";

#define OLED_W        128
#define OLED_PAGES    8
#define OLED_COL_OFF  2      /* SH1106 starts at column 2; harmless on SSD1306 */
#define GLYPH_W       6      /* 5 px + 1 px gap */
#define LINE_CHARS    (OLED_W / GLYPH_W)   /* 21 */

static i2c_master_dev_handle_t s_dev = NULL;
static uint8_t s_fb[OLED_PAGES][OLED_W];

/* 5x7, ASCII 0x20..0x7e, column-major. Enough for the status pages; the glyphs
 * that matter here are digits, lowercase and a few symbols. */
static const uint8_t FONT[95][5] = {
    {0x00,0x00,0x00,0x00,0x00}, {0x00,0x00,0x5f,0x00,0x00}, {0x00,0x07,0x00,0x07,0x00},
    {0x14,0x7f,0x14,0x7f,0x14}, {0x24,0x2a,0x7f,0x2a,0x12}, {0x23,0x13,0x08,0x64,0x62},
    {0x36,0x49,0x55,0x22,0x50}, {0x00,0x05,0x03,0x00,0x00}, {0x00,0x1c,0x22,0x41,0x00},
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    {0x00,0x41,0x36,0x08,0x00}, {0x08,0x08,0x2a,0x1c,0x08},
};

static esp_err_t cmd(uint8_t c)
{
    const uint8_t buf[2] = { 0x00, c };   /* 0x00 = command stream */
    return i2c_master_transmit(s_dev, buf, sizeof(buf), 100);
}

/* One page, straight out of the framebuffer. Page addressing rather than
 * horizontal mode so the same code drives both controllers. */
static esp_err_t flush_page(uint8_t page)
{
    esp_err_t err = cmd(0xb0 | page);                       /* page start */
    if (err == ESP_OK) err = cmd(0x00 | (OLED_COL_OFF & 0x0f));  /* col low  */
    if (err == ESP_OK) err = cmd(0x10 | (OLED_COL_OFF >> 4));    /* col high */
    if (err != ESP_OK) return err;

    uint8_t buf[1 + OLED_W];
    buf[0] = 0x40;                                          /* data stream */
    memcpy(&buf[1], s_fb[page], OLED_W);
    return i2c_master_transmit(s_dev, buf, sizeof(buf), 100);
}

static void flush(void)
{
    for (uint8_t p = 0; p < OLED_PAGES; p++) {
        if (flush_page(p) != ESP_OK) {
            ESP_LOGW(TAG, "page %u would not write — display gone?", p);
            return;
        }
    }
}

static void draw_at(uint8_t page, uint8_t x, const char *s)
{
    if (page >= OLED_PAGES) return;
    for (; *s && x + GLYPH_W <= OLED_W; s++, x += GLYPH_W) {
        unsigned char c = (unsigned char)*s;
        if (c < 0x20 || c > 0x7e) c = '?';
        memcpy(&s_fb[page][x], FONT[c - 0x20], 5);
        s_fb[page][x + 5] = 0x00;
    }
}

static void draw_text(uint8_t page, const char *s)
{
    draw_at(page, 0, s);
}

/* Right-aligned, for the one number that belongs at the far edge. Anything that
 * would collide with the left-hand text is drawn from column 0 instead — an
 * overlap is unreadable, and a badge shoved left is merely ugly. */
static void draw_right(uint8_t page, const char *s, uint8_t left_used)
{
    size_t n = strlen(s);
    if (n == 0 || n > LINE_CHARS) return;
    uint8_t x = (uint8_t)(OLED_W - n * GLYPH_W);
    if (x < left_used + GLYPH_W) x = left_used + GLYPH_W;
    draw_at(page, x, s);
}

bool oled_init(uint8_t i2c_port)
{
    if (i2c_port == 0xff) {
        ESP_LOGW(TAG, "no display was found on either bus — nothing to draw on");
        return false;
    }
    i2c_master_bus_handle_t bus = board_i2c_bus(i2c_port);
    if (bus == NULL) {
        ESP_LOGE(TAG, "i2c%u is not up", i2c_port);
        return false;
    }

    i2c_device_config_t dev_cfg = {
        .dev_addr_length = I2C_ADDR_BIT_LEN_7,
        .device_address = LG_ADDR_OLED,
        .scl_speed_hz = 400000,     /* the panel is happy at 400 kHz */
    };
    if (i2c_master_bus_add_device(bus, &dev_cfg, &s_dev) != ESP_OK) {
        ESP_LOGE(TAG, "could not attach to 0x%02x", LG_ADDR_OLED);
        s_dev = NULL;
        return false;
    }

    /* Init sequence common to both controllers, plus SH1106's charge pump
     * (0xad 0x8b). An SSD1306 ignores it and runs off its own pump command,
     * which is why 0x8d 0x14 follows. */
    static const uint8_t seq[] = {
        0xae,             /* display off */
        0xd5, 0x80,       /* clock divide */
        0xa8, 0x3f,       /* multiplex = 64 rows */
        0xd3, 0x00,       /* display offset */
        0x40,             /* start line 0 */
        0xad, 0x8b,       /* SH1106 charge pump on */
        0x8d, 0x14,       /* SSD1306 charge pump on */
        0xa1,             /* segment remap — the panel is mounted mirrored */
        0xc8,             /* scan direction reversed, ditto */
        0xda, 0x12,       /* COM pins: alternative */
        0x81, 0x9f,       /* contrast */
        0xd9, 0x22,       /* pre-charge */
        0xdb, 0x40,       /* VCOMH */
        0xa4,             /* follow RAM, not all-on */
        0xa6,             /* not inverted */
        0x20, 0x02,       /* page addressing */
        0xaf,             /* display on */
    };
    for (size_t i = 0; i < sizeof(seq); i++) {
        if (cmd(seq[i]) != ESP_OK) {
            ESP_LOGE(TAG, "init byte %u (0x%02x) not acknowledged", (unsigned)i, seq[i]);
            i2c_master_bus_rm_device(s_dev);
            s_dev = NULL;
            return false;
        }
    }

    memset(s_fb, 0, sizeof(s_fb));
    flush();
    ESP_LOGI(TAG, "display up on i2c%u at 0x%02x, 128x64, %d chars per line",
             i2c_port, LG_ADDR_OLED, LINE_CHARS);
    return true;
}

void oled_lines(const char *const *lines, uint8_t count)
{
    oled_lines_badge(lines, count, NULL);
}

void oled_lines_badge(const char *const *lines, uint8_t count, const char *badge)
{
    if (s_dev == NULL) return;
    memset(s_fb, 0, sizeof(s_fb));
    /* Six lines on eight pages: the text sits on every page except the two the
     * layout leaves as breathing room (the gap under the header). */
    static const uint8_t page_of[6] = { 0, 2, 3, 4, 5, 7 };
    for (uint8_t i = 0; i < count && i < 6; i++) {
        if (lines[i]) draw_text(page_of[i], lines[i]);
    }

    /* The badge is the one number you should be able to read across a table
     * without reading the rest: how many phones are attached. It sits at the far
     * right of the header. */
    if (badge && count > 0 && lines[0]) {
        draw_right(0, badge, (uint8_t)(strlen(lines[0]) * GLYPH_W));
    }

    /* A solid header bar with the text knocked out of it, rather than a hairline
     * rule under the name. On a 128x64 panel read at arm's length the bar is what
     * separates "the node" from "what the node is doing" at a glance; a 1 px rule
     * disappears at that distance. Inverting the whole page costs one XOR. */
    for (uint8_t x = 0; x < OLED_W; x++) s_fb[0][x] ^= 0xff;

    flush();
}

void oled_splash(const char *detail)
{
    const char *lines[] = {
        "lokalgrid",
        "one node, everyone",
        "on one map",
        "",
        detail ? detail : "starting up",
        "",
    };
    oled_lines(lines, 6);
}
